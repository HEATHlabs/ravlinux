/dts-v1/;
/include/ "shmac.dtsi"

/ {
	compatible = "shmac,shmac";
	model = "SHMAC";

	memory {
               device_type = "memory";
               reg = <0x0 0x02000000>; // 32M at 0x0
	};

        soc {
                uart0: uart@ffff0000 {
                        status = "ok";
                };
        };

};

